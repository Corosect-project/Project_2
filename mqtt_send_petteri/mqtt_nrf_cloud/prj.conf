## CMakeLists.txt
```
# SPDX-License-Identifier: Apache-2.0

cmake_minimum_required(VERSION 3.20.0)

find_package(Zephyr REQUIRED HINTS $ENV{ZEPHYR_BASE})
project(hello_world)

target_sources(app PRIVATE src/main.c)
target_sources(app PRIVATE src/config.c)
target_sources(app PRIVATE src/mqtt.c)
target_sources(app PRIVATE src/mqtt.h)
target_sources(app PRIVATE src/config.h)
target_sources(app PRIVATE src/config.h)
```

## prj.conf
```kconfig
CONFIG_NEWLIB_LIBC=y
CONFIG_NEWLIB_LIBC_FLOAT_PRINTF=y
CONFIG_DK_LIBRARY=y
CONFIG_HEAP_MEM_POOL_SIZE=256
CONFIG_GPIO=y
# Enable Bluetooth Low Energy
CONFIG_BT=y
CONFIG_BT_PERIPHERAL=y
CONFIG_BT_CENTRAL=y
CONFIG_BT_HCI=y
CONFIG_BT_CTLR=y

# Enable Zephyr Log API
CONFIG_LOG=y
CONFIG_LOG_PRINTK=y

# Enable Networking
CONFIG_NETWORKING=y
CONFIG_BT_SMP=y
CONFIG_BT_L2CAP_DYNAMIC_CHANNEL=y
CONFIG_NET_L2_BT=y
CONFIG_NET_DEFAULT_IF_BLUETOOTH=y
CONFIG_NET_TCP=y

CONFIG_NET_PKT_RX_COUNT=10
CONFIG_NET_PKT_TX_COUNT=10
CONFIG_NET_BUF_RX_COUNT=20
CONFIG_NET_BUF_TX_COUNT=20
CONFIG_NET_IF_UNICAST_IPV6_ADDR_COUNT=3
CONFIG_NET_IF_MCAST_IPV6_ADDR_COUNT=4
CONFIG_NET_MAX_CONTEXTS=6

# CONFIG_NET_CONFIG_NEED_IPV6=y
CONFIG_NET_CONFIG_BT_NODE=y
CONFIG_NET_CONFIG_AUTO_INIT=n
CONFIG_NET_CONFIG_SETTINGS=y
CONFIG_NET_CONFIG_MY_IPV6_ADDR="2001:db8::1"

CONFIG_NET_LOG=y
# CONFIG_BT_L2CAP_LOG_LEVEL_DBG=y
# CONFIG_NET_L2_BT_LOG_LEVEL_DBG=y
# CONFIG_NET_CORE_LOG_LEVEL_DBG=y
# CONFIG_NET_IF_LOG_LEVEL_DBG=y
# CONFIG_NET_TC_LOG_LEVEL_DBG=y
# CONFIG_NET_CONTEXT_LOG_LEVEL_DBG=y
# CONFIG_NET_CONN_LOG_LEVEL_DBG=y
# CONFIG_NET_CONFIG_LOG_LEVEL_DBG=y
# CONFIG_NET_TCP_LOG_LEVEL_DBG=y

#CONFIG_CJSON_LIB=y 
CONFIG_MAIN_STACK_SIZE=2048
CONFIG_MQTT_LIB=y
CONFIG_MQTT_LIB_TLS=y
CONFIG_NRF_CLOUD_FOTA=n

CONFIG_NRF_CLOUD_MQTT=y

CONFIG_BT_HOST_CCM=y
CONFIG_HW_ID_LIBRARY=y
CONFIG_HW_ID_LIBRARY_SOURCE_BLE_MAC=y


CONFIG_PINCTRL=y
CONFIG_BUILD_WITH_TFM=y
CONFIG_PARTITION_MANAGER_ENABLED=y
CONFIG_PM=y

CONFIG_AWS_IOT=y
```

## src/main.c
```c
/*
 * Copyright (c) 2023 OAMK Corosect-project.
 * and 2023 OAMK Corosect-project 2. 
 * nRF cloud functionality added
 *  
 * SPDX-License-Identifier: MIT
 */

#include <dk_buttons_and_leds.h>
#include <nrfx_spim.h>
#include <zephyr/bluetooth/bluetooth.h>
#include <zephyr/bluetooth/conn.h>
#include <zephyr/bluetooth/l2cap.h>
#include <zephyr/bluetooth/uuid.h>
#include <zephyr/kernel.h>
#include <zephyr/logging/log.h>
#include <zephyr/net/mqtt.h>
#include <net/nrf_cloud.h>
#include <stdio.h>
#include <stdint.h>
#include <inttypes.h>


LOG_MODULE_REGISTER(app, LOG_LEVEL_DBG);

#include "config.h"
#include "mqtt.h"

#define ERROR(err) (err < 0)
#define ZEPHYR_ADDR "2001:db8::1"
#define SERVER_ADDR "2001:db8::2"
#define SERVER_PORT 1883

//Define in case you want use nrf_cloud
#define nrf_cloud 

volatile bool quit = false;
static const struct bt_data ad[] = {
    BT_DATA_BYTES(BT_DATA_FLAGS, (BT_LE_AD_GENERAL | BT_LE_AD_NO_BREDR)),
    BT_DATA_BYTES(BT_DATA_UUID16_ALL, BT_UUID_16_ENCODE(0x1820)),
};

void button_handler(uint32_t state, uint32_t has_changed);
void bt_ready();
static void bt_connected(struct bt_conn *conn, uint8_t err);
static void bt_disconnected(struct bt_conn *conn, uint8_t reason);

BT_CONN_CB_DEFINE(con_calbacks) = {.connected = bt_connected, .disconnected = bt_disconnected};

//Topics and data getting to program
struct topic_and_data {
  uint32_t topic_data_size;
  uint32_t message_data_size;
  uint8_t topic_data;
  uint8_t message_data;
};

struct topic_and_data nrf_cloud_topic_and_data(){ //nRF cloud topic and data
  LOG_INF("Running nrf cloud initializer");
  struct topic_and_data data; //Data getting to program

  //Message and topic
  uint8_t * message = "Hello world from Zephyr";
  uint8_t * topic = "TEST";

  //Team id for nRF cloud
  uint8_t team_id_topic[] = "prod/c88885a4-8051-438f-8bbf-359b3f62a586"; 
  
  //Client id for device
  //uint8_t client_id_topic[] = "683909493";
  
  //Data connect to same variable
  uint8_t topic_full = ""; 

  //Connecting data to same that printed in topic 
  sprintf(topic_full,"${mqttTopicPrefix}/m/d/${CC:FC:5C:5D:B1:7B}/d2c/%s/%s/${iot:ClientId}", team_id_topic, &topic);

  //Calculating topic and message size
  uint32_t topic_size = strlen((const char *)topic_full);
  uint32_t message_size = strlen(message);

  data.message_data = (uint8_t)message;
  data.message_data_size = message_size;
  data.topic_data = topic_full;
  data.topic_data_size = topic_size;
  return data;
}

void main(void) {

  
  int32_t err;
  LOG_INF("Hello World! %s", CONFIG_BOARD);
  
  if (ERROR(dk_buttons_init(button_handler))) LOG_ERR("Error initializing buttons");

  err = bt_enable(NULL);
  if (ERROR(err)) LOG_ERR("Error enabling BT %d", err);
  bt_ready();

  LOG_DBG("Waiting connection...");
  k_sleep(K_MSEC(30000));
  LOG_DBG("Continuing");
  init_network(ZEPHYR_ADDR);
  
  #ifdef nrf_cloud //If using nrf cloud
  LOG_DBG("Nrf cloud running");
  //nrf cloud initalizing and sending topic and message address to initializer
  struct topic_and_data data_to_program = nrf_cloud_topic_and_data();

  initializer_nrf_cloud(&data_to_program.message_data, data_to_program.message_data_size, &data_to_program.topic_data, data_to_program.topic_data_size); 
  #endif


  struct mqtt_client *client_ctx = init_mqtt(SERVER_ADDR, SERVER_PORT);

  for (size_t i = 0; i < 11; i++) {
    err = mqtt_connect(client_ctx);
    if (err != 0) {
      LOG_ERR("MQTT ERROR: %d", err);
      while (!quit) {
        k_sleep(K_MSEC(1000));
      }
      return;
    }

    err = zsock_poll(fds, 1, 10000);
    LOG_DBG("POLL ret, %d", err);
    err = mqtt_input(client_ctx);
    if (ERROR(err)) LOG_ERR("Input error, %d", err);
    LOG_DBG("%d", connected);
    k_sleep(K_SECONDS(5));
    if (!connected) {
      err = mqtt_abort(client_ctx);
      LOG_ERR("Connection aborted, %d", err);
    } else break;
  }

  if (connected) {

    //In case you want to use nRF cloud
    #ifdef nrf_cloud 

    //Getting data_and topic 
    struct topic_and_data data_to_mqtt = nrf_cloud_topic_and_data();

    //err = nrf_cloud_send_data_mqtt(topic_size, data_team_id_topic);
    err = send_message(&(data_to_mqtt.message_data), &(data_to_mqtt.topic_data));
    #elif
    uint8_t *message = "Hello world from Zephyr";
    uint8_t *topic = "TEST";
    err = send_message(message, topic);
    #endif

    if (err) LOG_ERR("SEND ERROR: %d", err);
  }

  while (!quit && connected) {
    err = zsock_poll(fds, 1, 5000);
    if (err > 0) {
      if (fds[0].revents & ZSOCK_POLLIN) {
        err = mqtt_input(client_ctx);
        LOG_ERR("%d", err);
      }
    } else if (ERROR(err)) LOG_ERR("%d", errno);
    err = mqtt_live(client_ctx);
    LOG_ERR("%d", err);
    LOG_DBG("WAITING");
    k_sleep(K_MSEC(2000));
  }

  LOG_INF("QUIT\n");
  err = mqtt_disconnect(client_ctx);
  LOG_DBG("Disconnected, %d", err);
  k_sleep(K_MSEC(1000));
  bt_le_adv_stop();
  bt_disable();
}

void button_handler(uint32_t state, uint32_t has_changed) {
  if (DK_BTN2_MSK == has_changed) {
    quit = true;
  }
}

void bt_ready() {
  uint32_t err = bt_le_adv_start(BT_LE_ADV_CONN_NAME, ad, ARRAY_SIZE(ad), 0, 0);
  if (err == -ENOMEM) LOG_ERR("ENOMEM\n");
  else if (err == -ECONNREFUSED || err == -EIO) LOG_ERR("ECONNREFUSED\n");
  LOG_DBG("%d\n", err);
}

void bt_connected(struct bt_conn *conn, uint8_t err) {
  if (err) {
    LOG_ERR("Connection failed, %d", err);
  } else {
    LOG_INF("Connected");
    // k_sleep(K_SECONDS(1));
    // init_network(ZEPHYR_ADDR);
  }
}

void bt_disconnected(struct bt_conn *conn, uint8_t reason) { LOG_INF("Disconnected, reason %d", reason); }
```

## src/config.c
```c
#include "config.h"

#include <zephyr/logging/log.h>
#include <zephyr/net/net_config.h>
#include <zephyr/net/net_if.h>
#include <zephyr/kernel.h>

LOG_MODULE_DECLARE(app, LOG_LEVEL_DBG);

static struct in6_addr my_addr;

 

/**
 * @brief Initialize network interface for later use
 *
 * @param ip this device's ip address
 */
void init_network(char *ip) {
  int err;

  struct net_if *iface = net_if_get_default();
  if (!iface) {
    LOG_ERR("Didn't get interface");
    return;
  }

  if (!net_if_is_admin_up(iface)) {
    LOG_ERR("IFACE is not admin up");
  }

  // Check if interface is up and set it up otherwise
  if (!net_if_is_up(iface)) {
    LOG_DBG("Setting iface up");
    err = net_if_up(iface);
    if (err < 0) LOG_ERR("Error setting iface to up, %d", err);
  }

  err = net_addr_pton(AF_INET6, ip, &my_addr);  // Convert the string to byte format and copy the address to in6_addr struct
  if (err < 0) LOG_ERR("Error on coppying ip, %d", err);
  struct net_if_addr *iface_addr = net_if_ipv6_addr_add(iface, &my_addr, NET_ADDR_MANUAL, 0);  // Add the address to the interface
  if (!iface_addr) LOG_ERR("Couldn't set ip");

  if (net_if_is_admin_up(iface) && net_if_is_carrier_ok(iface) && !net_if_is_dormant(iface)) {
    LOG_DBG("IF STATUS: OPER UP");
  }

  LOG_DBG("Start net_config");
  err = net_config_init_by_iface(iface, "Zephyr MQTT", NET_CONFIG_NEED_IPV6, 30000);  // Initialize rest of the network stack
  if (err < 0) LOG_ERR("Initialization error, %d", err);
  LOG_DBG("Network setup done");
}
```

## src/config.h
```c
#ifndef BF497F20_BB34_484E_BD6B_05FB88F2766D
#define BF497F20_BB34_484E_BD6B_05FB88F2766D

void init_network(char *ip);

#endif /* BF497F20_BB34_484E_BD6B_05FB88F2766D */
```

## src/mqtt.c
```c
#include "mqtt.h"
#include <stdio.h>
#include <zephyr/kernel.h>
#include <zephyr/logging/log.h>

#include <net/nrf_cloud.h>

LOG_MODULE_DECLARE(app, LOG_LEVEL_DBG);

// MQTT global variables
struct zsock_pollfd fds[1] = {0};
bool connected = false;

// MQTT
static uint8_t rx_buffer[256];
static uint8_t tx_buffer[256];
static struct mqtt_client client_ctx;
static struct sockaddr_storage broker;


void mqtt_evt_handler(struct mqtt_client *client, const struct mqtt_evt *evt);



/**
 * @brief Initialize mqtt parameters and set broker ip and port
 *
 * @param server_ip broker's ip address
 * @param port broker's port
 * @return Pointer to the client struct or NULL on failure
 */
struct mqtt_client *init_mqtt(const char *server_ip, uint32_t port) {

  uint32_t err;

  uint8_t *client_id = "ZEPHYR";
  mqtt_client_init(&client_ctx);
  client_ctx.broker = &broker;
  client_ctx.evt_cb = mqtt_evt_handler;
  client_ctx.client_id.utf8 = client_id;
  client_ctx.client_id.size = sizeof(client_id) - 1;
  client_ctx.password = NULL;   // No password
  client_ctx.user_name = NULL;  // No username
  client_ctx.protocol_version = MQTT_VERSION_3_1_1;
  client_ctx.transport.type = MQTT_TRANSPORT_SECURE;  // No TLS certificates

  client_ctx.rx_buf = rx_buffer;
  client_ctx.rx_buf_size = sizeof(rx_buffer);
  client_ctx.tx_buf = tx_buffer;
  client_ctx.tx_buf_size = sizeof(tx_buffer);


  struct mqtt_sec_config *tls_config = &client_ctx.transport.tls.config;

  static int m_sec_tags[] =  {2,3};

  tls_config->peer_verify = TLS_PEER_VERIFY_REQUIRED;
  tls_config->cipher_list = NULL;
  tls_config->sec_tag_list = m_sec_tags;
  tls_config->sec_tag_count = ARRAY_SIZE(m_sec_tags);
  tls_config->hostname = "Test";
  tls_config->set_native_tls = true;


  struct sockaddr_in6 *broker6 = (struct sockaddr_in6 *)&broker;
  memset(broker6, 0, sizeof(*broker6));  // Zero the struct

  broker6->sin6_family = AF_INET6;
  broker6->sin6_port = htons(port);
  err = net_addr_pton(AF_INET6, server_ip, &broker6->sin6_addr);  // Assign broker's ip address to sockaddr struct
  LOG_DBG("TEST: %d", err);
  // zsock_inet_pton(AF_INET6, SERVER_ADDR, &broker6->sin6_addr);

  // Set pollable events for later use
  fds[0].fd = client_ctx.transport.tcp.sock;
  fds[0].events = ZSOCK_POLLIN;

  if (err == 0) return &client_ctx;
  else return NULL;
}

/**
 * @brief Publish message to specific topic
 *
 * @param msg message string
 * @param topic MQTT topic
 * @return 0 or negative error code (Zephyr errno.h)
 */
int send_message(char *msg, char *topic) {
  struct mqtt_publish_param param = {0};
 
  param.message.payload.data = msg;
  param.message.payload.len = strlen(msg);
  param.message.topic.qos = MQTT_QOS_0_AT_MOST_ONCE;
  param.message.topic.topic.utf8 = topic;
  param.message.topic.topic.size = strlen(topic);
  return mqtt_publish(&client_ctx, &param);
}

void mqtt_evt_handler(struct mqtt_client *client, const struct mqtt_evt *evt) {
  LOG_ERR("MQTT_CALLBACK");
  switch (evt->type) {
    case MQTT_EVT_CONNACK:
      if (evt->result != 0) {
        LOG_ERR("Error connecting: %d", evt->result);
        break;
      }
      LOG_INF("MQTT connected");
      connected = true;
      break;
    case MQTT_EVT_DISCONNECT:
      LOG_INF("MQTT disconnected");
      connected = false;
      break;
    case MQTT_EVT_PINGRESP:
      LOG_INF("Ping response");
      break;
    default:
      LOG_INF("MQTT default");
      break;
  }
}



//Nrf cloud funcionality starts after this:



//NRF cloud data initalization saving
struct data_nrf_initialize{

  void const* msg_ptr; //Message data ptr
  uint32_t msg_ptr_size; //Message size ptr
  void const* tpc_ptr; //Topic size ptr
  uint32_t msg_tpc_size; //Topic ptr

}nrf_cloud_initialize;


//nRF cloud handler
void cloud_handler(struct nrf_cloud_evt *evt) {

  evt->type = NRF_CLOUD_EVT_TRANSPORT_CONNECTED;
  evt->data.len = nrf_cloud_initialize.msg_ptr_size; //Lenght of data
  evt->data.ptr = nrf_cloud_initialize.msg_ptr; //Pointer to data
  evt->topic.len = nrf_cloud_initialize.msg_tpc_size; //Lenght of topic
  evt->topic.ptr = nrf_cloud_initialize.tpc_ptr; //Pointer to topic
}



/*
  Initialize data for nrf_cloud
  Needed data for intialize is
  mqtt and topic size AND
  mqtt and topic pointers
  How data goes to this function
  uint8_t &data_to_program.message_data,
  uint32_t data_to_program.message_data_size,
  uint8_t &data_to_program.topic_data, 
  uint32_t data_to_program.topic_data_size
*/

void initializer_nrf_cloud(void const* message_ptr, uint32_t message_data_size, void const* topic_ptr, uint32_t message_topic_size){ 

  //Making variable global for program
  nrf_cloud_initialize.msg_ptr = message_ptr;
  nrf_cloud_initialize.msg_ptr_size = message_data_size;
  nrf_cloud_initialize.tpc_ptr = topic_ptr;
  nrf_cloud_initialize.msg_tpc_size = message_topic_size;

  LOG_INF("Running initializer to nrf cloud");
  //Nrf cloud struct usage
  struct nrf_cloud_init_param Nrf_ble_cloud;
  Nrf_ble_cloud.client_id = NULL; 
  //Set to null unless NRF_CLOUD_CLIENT_ID_SRC_RUNTIME is set
  Nrf_ble_cloud.event_handler = cloud_handler;

  //const struct Nrf_ble_cloud2 *nrf_ble_cloud_final;
  
  //Initalizing nrf cloud connection
  int error = nrf_cloud_init(&Nrf_ble_cloud);

  
  //Testing if initializing returns error
  if(error != 0 ) LOG_ERR("Error in initializing of nrf cloud: %d", error);

  //Connecting to nrf cloud
  nrf_cloud_connect();

}


void nrf_cloud_send_data_mqtt(uint32_t mqtt_lenght, const void * pointer_mqtt()){

  //Mqtt topic for nRF cloud
  struct nrf_cloud_topic Nrf_send_mqtt;
  Nrf_send_mqtt.len = mqtt_lenght;
  Nrf_send_mqtt.ptr = pointer_mqtt();

}
```

## src/mqtt.h
```c
#ifndef D2AE867A_AFDC_452A_AB8B_77B11E1601C5
#define D2AE867A_AFDC_452A_AB8B_77B11E1601C5

#include <zephyr/kernel.h>
#include <zephyr/net/mqtt.h>
#include <zephyr/net/socket.h>

extern bool connected;
extern struct zsock_pollfd fds[1];

struct mqtt_client *init_mqtt(const char *ip, uint32_t port);
int send_message(char *msg, char *topic);

#endif /* D2AE867A_AFDC_452A_AB8B_77B11E1601C5 */
```
